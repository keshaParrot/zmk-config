/ {
    keymap {
        compatible = "zmk,keymap";

        default_layer {
            bindings = <
                &kp A &kp B &kp C &kp D &kp E &kp F &kp G &kp H &kp I &kp J &kp K &kp L &kp M &kp N &kp O
                &kp P &kp Q &kp R &kp S &kp T &kp U &kp V &kp W &kp X &kp Y &kp Z &kp 1 &kp 2 &kp 3 &kp 4
                &kp 5 &kp 6 &kp 7 &kp 8 &kp 9 &kp 0 &kp ENTER &kp ESC &kp TAB &kp SPACE &kp MINUS &kp EQUAL &kp BSPC &kp LSHIFT &kp RSHIFT &kp LCTRL &kp RCTRL &kp LALT &kp RALT &kp LGUI &kp RGUI &none &none &none &none &none &none &none &none &none &none &none &none &none &none &none &none &none &none &none &none
            >;
        };
    };
};
